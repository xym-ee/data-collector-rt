## board/Kconfig
```kconfig
menu "Hardware Drivers Config"

config SOC_STM32F407VG
    bool
    select SOC_SERIES_STM32F4
    select RT_USING_COMPONENTS_INIT
    select RT_USING_USER_MAIN
    default y

menu "Onboard Peripheral Drivers"

endmenu

menu "On-chip Peripheral Drivers"

    config BSP_USING_GPIO
        bool "Enable GPIO"
        select RT_USING_PIN
        default y

    menuconfig BSP_USING_UART
        bool "Enable UART"
        default y
        select RT_USING_SERIAL
        if BSP_USING_UART

            config BSP_USING_UART1
                bool "Enable UART1"
                default y
            config BSP_UART1_RX_USING_DMA
                bool "Enable UART1 RX DMA"
                depends on BSP_USING_UART1 && RT_SERIAL_USING_DMA
                default n

            config BSP_USING_UART2
                bool "Enable UART2"
                default y
            config BSP_UART2_RX_USING_DMA
                bool "Enable UART2 RX DMA"
                depends on BSP_USING_UART2 && RT_SERIAL_USING_DMA
                default n

            config BSP_USING_UART3
                bool "Enable UART3"
                default y
            config BSP_UART3_RX_USING_DMA
                bool "Enable UART3 RX DMA"
                depends on BSP_USING_UART3 && RT_SERIAL_USING_DMA
                default n
                
            config BSP_USING_UART4
                bool "Enable UART4"
                default y
            config BSP_UART4_RX_USING_DMA
                bool "Enable UART4 RX DMA"
                depends on BSP_USING_UART4 && RT_SERIAL_USING_DMA
                default n

            config BSP_USING_UART5
                bool "Enable UART5"
                default y
            config BSP_UART5_RX_USING_DMA
                bool "Enable UART5 RX DMA"
                depends on BSP_USING_UART5 && RT_SERIAL_USING_DMA
                default n

            config BSP_USING_UART6
                bool "Enable UART6"
                default y
            config BSP_UART6_RX_USING_DMA
                bool "Enable UART6 RX DMA"
                depends on BSP_USING_UART6 && RT_SERIAL_USING_DMA
                default n
        endif

    menuconfig BSP_USING_SPI
    bool "Enable SPI BUS"
    default n
    select RT_USING_SPI
    if BSP_USING_SPI
        config BSP_USING_SPI2
            bool "Enable SPI2 BUS"
            default n

        config BSP_SPI2_TX_USING_DMA
            bool "Enable SPI2 TX DMA"
            depends on BSP_USING_SPI2
            default n

        config BSP_SPI2_RX_USING_DMA
            bool "Enable SPI2 RX DMA"
            depends on BSP_USING_SPI2
            select BSP_SPI2_TX_USING_DMA
            default n
    endif


    menuconfig BSP_USING_ADC
        bool "Enable ADC"
        default n
        select RT_USING_ADC
        if BSP_USING_ADC
            config BSP_USING_ADC1
                bool "Enable ADC1"
                default n
            config BSP_USING_ADC3
                bool "Enable ADC3"
                default n
        endif

    menuconfig BSP_USING_I2C3
        bool "Enable I2C3 BUS (software simulation)"
        default n
        select RT_USING_I2C
        select RT_USING_I2C_BITOPS
        select RT_USING_PIN
        if BSP_USING_I2C3
            comment "Notice: PA8 --> 8; PC9 --> 41"
            config BSP_I2C3_SCL_PIN
                int "i2c3 scl pin number"
                default 8
            config BSP_I2C3_SDA_PIN
                int "I2C3 sda pin number"
                default 41
        endif


    source "libraries/HAL_Drivers/Kconfig"
    
endmenu

menu "Board extended module Drivers"

endmenu
 
endmenu
```
